## imx/meta-imx8mp-ai-robot/conf/layer.conf
```bitbake
# We have a conf and classes directory, add to BBPATH
BBPATH .= ":${LAYERDIR}"

# We have recipes-* directories, add to BBFILES
BBFILES += "${LAYERDIR}/recipes-*/*/*.bb \
            ${LAYERDIR}/recipes-*/*/*.bbappend"

BBFILE_COLLECTIONS += "ai-robot"
BBFILE_PATTERN_ai-robot = "^${LAYERDIR}/"
BBFILE_PRIORITY_ai-robot = "8"
LAYERSERIES_COMPAT_ai-robot = "kirkstone"
```

## imx/meta-imx8mp-ai-robot/conf/machine/imx8mp-ai-robot.conf
```bitbake
#@TYPE: Machine
#@NAME: NXP i.MX8MP AI ROBOT BOARD
#@SOC: i.MX8MP
#@DESCRIPTION: Machine configuration for NXP i.MX8MP AI ROBOT
#@MAINTAINER: Xiaodong Zhang <xiaodong.zhang@nxp.com>

require conf/machine/include/imx8mp-evk.inc

SERIAL_CONSOLES = "115200;ttymxc0"

KERNEL_DEVICETREE:append:use-nxp-bsp = " \
                        freescale/imx8mp-ai-robot.dtb \
                        freescale/imx8mp-ai-robot-root.dtb \
                        freescale/imx8mp-ai-robot-powertip-lvds-panel.dtb \
                        freescale/imx8mp-ai-robot-rk070cu05h.dtb \
                        freescale/imx8mp-ai-robot-auo-lvds-panel.dtb \
                        freescale/imx8mp-ai-robot-boe-lvds-panel.dtb \
"
# FIXME: This machine is not yet supported by u-boot-fslc, so for now
# use u-boot-imx for mainline.
IMX_DEFAULT_BOOTLOADER:use-mainline-bsp = "u-boot-imx"
KERNEL_DEVICETREE_BASENAME = "${MACHINE}"

UBOOT_CONFIG_BASENAME = "imx8mp_ai_robot"

# Set DDR FIRMWARE
DDR_FIRMWARE_VERSION = "202006"
DDR_FIRMWARE_NAME = " \
    ddr4_dmem_1d_${DDR_FIRMWARE_VERSION}.bin \
    ddr4_imem_1d_${DDR_FIRMWARE_VERSION}.bin \
    ddr4_dmem_2d_${DDR_FIRMWARE_VERSION}.bin \
    ddr4_imem_2d_${DDR_FIRMWARE_VERSION}.bin \
"

IMXBOOT_TARGETS_BASENAME = "flash_ai_robot"

# Mainline BSP doesn't support DDR4 so it must be set to nxp.
# Also this machine isn't supported by u-boot-fslc but imx8mp-evk.inc already
# set the bootloader to u-boot-imx instead when NXP BSP is used.
IMX_DEFAULT_BSP = "nxp"
```

## imx/meta-robot/conf/distro/imx-robot-x11.conf
```bitbake
include conf/distro/include/fsl-imx-base.inc
include conf/distro/include/fsl-imx-preferred-env.inc
include conf/distro/include/imx-robot-env.inc

DISTRO = "imx-robot-x11"
DISTRO_NAME = "i.MX Robot platform distribution"
DISTRO_VERSION = "1.0" 
DISTRO_CODENAME = "i.MX Robot"
# Remove conflicting backends.
DISTRO_FEATURES:remove = "wayland ptest"
# These are X11 specific
DISTRO_FEATURES:append = " x11"
```

## imx/meta-robot/conf/distro/imx-robot-xwayland.conf
```bitbake
include conf/distro/include/fsl-imx-base.inc
include conf/distro/include/fsl-imx-preferred-env.inc
include conf/distro/include/imx-robot-env.inc

DISTRO = "imx-robot-xwayland"
DISTRO_NAME = "i.MX Robot platform distribution"
DISTRO_VERSION = "1.0" 
DISTRO_CODENAME = "i.MX Robot"
DISTRO_FEATURES:remove = "directfb ptest "
DISTRO_FEATURES:append = "x11 wayland pam "  
```

## imx/meta-robot/conf/distro/include/imx-robot-env.inc
```bitbake
hostname:pn-base-files ?= "imx-robot"

# Use i.MX real time Kernel providers
#XENOMAI_KERNEL_MODE ?= "cobalt"
#XENOMAI_KERNEL_MODE ?= "mercury"
PREFERRED_VERSION_openblas ?= "0.3.17"
PREFERRED_VERSION_openssl ?= "3.1.0.imx"
PREFERRED_VERSION_cryptodev-linux ?= "1.12.imx"
PREFERRED_VERSION_cryptodev-module ?= "1.12.imx"
PREFERRED_VERSION_cryptodev-tests ?= "1.12.imx"
PREFERRED_VERSION_libg2o ?= "20201223"
```

## imx/meta-robot/conf/layer.conf
```bitbake
# We have a conf and classes directory, add to BBPATH
BBPATH .= ":${LAYERDIR}"

# We have a packages directory, add to BBFILES
BBFILES += "${LAYERDIR}/recipes-*/*/*.bb \
            ${LAYERDIR}/recipes-*/*/*.bbappend"

BBFILE_COLLECTIONS += "imx-robot"
BBFILE_PATTERN_imx-robot := "^${LAYERDIR}"
BBFILE_PRIORITY_imx-robot = "8"
LAYERSERIES_COMPAT_imx-robot = "kirkstone"
```
